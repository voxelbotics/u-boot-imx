## board/voxelbotics/navqp/Kconfig
```kconfig
if TARGET_NAVQP

config SYS_BOARD
	default "navqp"

config SYS_VENDOR
	default "voxelbotics"

config SYS_CONFIG_NAME
	default "navqp"

config IMX_CONFIG
	default "board/freescale/imx8mp_evk/imximage-8mp-lpddr4.cfg"

source "board/freescale/common/Kconfig"

endif
```
